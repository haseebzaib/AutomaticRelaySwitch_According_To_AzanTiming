## RelaySwitching/modules/RTCmcp7940/Kconfig
```kconfig
menuconfig CUSTOM_RTCMCP7940
    bool "RealTime clock with battery backed SRAM"
    select I2C
    help
      Enable the RTC mcp7940 custom driver.

if CUSTOM_RTCMCP7940

config CUSTOM_RTCMCP7940_LOG_LEVEL
    int "Log level for custom driver RTCmcp7940"
    default 0
    depends on LOG
    help
      Set the log level for RTCmcp7940 driver (0=off, 1=error, 2=warning, 3=info, 4=debug).


config CUSTOM_RTCMCP7940_INIT_PRIORITY
    int "Initialization priority for RTC MCP7940 driver"
    default 90
    range 0 99
    help
      Set the initialization priority for the RTC MCP7940 driver.
      Lower numbers mean higher priority.


endif
```

## RelaySwitching/modules/ssd1306/kconfig
```kconfig
menuconfig CUSTOM_SSD1306
    bool "SSD1306 display"
    select I2C
    help
      Enable the display custom driver.

if CUSTOM_SSD1306

config CUSTOM_SSD1306_LOG_LEVEL
    int "Log level for custom driver ssd1306"
    default 0
    depends on LOG
    help
      Set the log level for ssd1306 driver (0=off, 1=error, 2=warning, 3=info, 4=debug).


config CUSTOM_SSD1306_INIT_PRIORITY
    int "Initialization priority for RTC MCP7940 driver"
    default 90
    range 0 99
    help
      Set the initialization priority for the ssd1306 driver.
      Lower numbers mean higher priority.


endif
```
